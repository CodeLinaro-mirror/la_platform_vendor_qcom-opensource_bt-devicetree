// SPDX-License-Identifier: BSD-3-Clause

/*
 * Copyright (c) Qualcomm Technologies, Inc. and/or its subsidiaries.
 */

#include <dt-bindings/interrupt-controller/arm-gic.h>
#include <dt-bindings/gpio/gpio.h>
#include <dt-bindings/interconnect/qcom,shikra.h>

// Using same compatible name as "wcn3990" since all "wcn39xx" are pin-compatible
&soc {
	bluetooth: bt_wcn3980_wcn_3950 {
		compatible = "qcom,wcn3990";
		qcom,bt-sw-ctrl-gpio = <&tlmm 88 GPIO_ACTIVE_HIGH>;
		qcom,bt-vdd-io-supply = <&L15A>;  /* IO */
		qcom,bt-vdd-core-supply = <&L10A>; /* RFA */
		qcom,bt-vdd-pa-supply = <&L22A>; /* CH0 */
		qcom,bt-vdd-xtal-supply = <&L13A>; /* XO */

		qcom,bt-vdd-io-config = <1700000 1900000 1 0>;
		qcom,bt-vdd-core-config = <1304000 1304000 1 0>;
		qcom,bt-vdd-pa-config = <3000000 3312000 1 0>;
		qcom,bt-vdd-xtal-config = <1700000 1900000 1 0>;
	};
};

&qupv3_se8_4uart {
    status = "ok";
};
