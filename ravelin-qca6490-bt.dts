
/* Copyright (c) Qualcomm Technologies, Inc. and/or its subsidiaries.
 *  SPDX-License-Identifier: BSD-3-Clause
 */

/dts-v1/;
/plugin/;

#include "ravelin-qca6490-bt.dtsi"

/ {
 	model = "Qualcomm Technologies, Inc. Ravelin";
 	compatible = "qcom,ravelin", "qcom,montague-idp", "qcom,montague", "qcom,idp", "qcom,montague-qmb";
	qcom,msm-id = <581 0x10000>, <582 0x10000>, <734 0x10000>, <773 0x10000>, <774 0x10000>;
    qcom,board-id = <0x10022 0x4>, <0x10022 0x5>, <0x10022 0xA>;
};

