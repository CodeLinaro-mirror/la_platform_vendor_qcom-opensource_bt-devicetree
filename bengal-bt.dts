// SPDX-License-Identifier: BSD-3-Clause
/*
 * Copyright (c) Qualcomm Technologies, Inc. and/or its subsidiaries.
 */

/dts-v1/;
/plugin/;

#include "bengal-bt.dtsi"
/ {
	model = "Qualcomm Technologies, Inc. Bengal";
	compatible = "qcom,scuba-idp", "qcom,scuba-iot", "qcom,idp", "qcom,bengal";
	qcom,msm-id = <474 0x10000>, <473 0x10000>;
	qcom,board-id = <34 0>;
};
