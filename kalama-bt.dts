/*
 * Copyright (c) Qualcomm Technologies, Inc. and/or its subsidiaries.
 * SPDX-License-Identifier: BSD-3-Clause.
 */

/dts-v1/;
/plugin/;

#include "kalama-bt.dtsi"

/ {
       model = "Qualcomm Technologies, Inc. Kalama SoCs";
       compatible = "qcom,kalama", "qcom,kalamap";
       qcom,msm-id = <519 0x10000>, <536 0x10000>, <519 0x20000>, <536 0x20000>;
       qcom,board-id = <0 0>;
};
