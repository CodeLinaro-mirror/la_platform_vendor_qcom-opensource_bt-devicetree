// SPDX-License-Identifier: BSD-3-Clause

/*
 * Copyright (c) 2026 Qualcomm Innovation Center, Inc. All rights reserved.
 */

/dts-v1/;
/plugin/;

#include "volcano-moselle-sdr735-wcd9395-bt.dtsi"

/ {
	model = "Qualcomm Technologies, Inc. Volcano SoC";
	compatible = "qcom,volcano";
	qcom,msm-id = <636 0x10000>, <640 0x10000>, <641 0x10000>, <0x4000291 0x10000>, <0x8000291 0x10000>,  <0xc000291 0x10000>, <0x10000291 0x10000>, <0x14000291 0x10000>, <0x4000292 0x10000>, <0x8000292 0x10000>, <0xc000292 0x10000>, <0x10000292 0x10000>;
	qcom,board-id = <8 15>;
};
